## CMakeLists.txt
```
#-------------------------------------------------------------------------------
# Zephyr Example Application
#
# Copyright (c) 2021 Nordic Semiconductor ASA
# SPDX-License-Identifier: Apache-2.0

cmake_minimum_required(VERSION 3.13.1)
find_package(Zephyr REQUIRED HINTS $ENV{ZEPHYR_BASE})

project(pslabel LANGUAGES C)

target_sources(app PRIVATE 
    src/main.c
    src/esl_service.c
)
```

## sample.yaml
```
# This file is provided so that the application can be compiled using Twister,
# the Zephyr testing tool. In this file, multiple combinations can be specified,
# so that you can easily test all of them locally or in CI.
sample:
  description: PSLabel application
  name: PSLabel
common:
  sysbuild: true
  build_only: true
  integration_platforms:
    - nrf54l15dk/nrf54l15/cpuapp
tests:
  app.default: {}
  app.debug:
    extra_overlay_confs:
      - debug.conf
```

## prj.conf
```kconfig
# Copyright (c) 2021 Nordic Semiconductor ASA
# SPDX-License-Identifier: Apache-2.0
#
# This file contains selected Kconfig options for the application.

CONFIG_SENSOR=y

# Bluetooth Stack Configuration
CONFIG_BT=y
CONFIG_BT_PERIPHERAL=y
CONFIG_BT_DEVICE_NAME="PSLabel"

# GATT Configuration
CONFIG_BT_GATT_CLIENT=y

# Bluetooth Controller - Extended Advertising (required for ESL)
CONFIG_BT_CTLR_ADV_EXT=y
CONFIG_BT_EXT_ADV=y

# Periodic Advertising Sync (for ESL peripheral/tag role)
CONFIG_BT_PER_ADV_SYNC=y

# ESL (Electronic Shelf Label) Profile
CONFIG_BT_ESL=y
```

## boards/nrf54l15dk_nrf54l15_cpuapp.overlay
```dts
/*
 * Copyright (c) 2025 Nordic Semiconductor ASA
 * SPDX-License-Identifier: Apache-2.0
 */

/* This devicetree overlay file will be automatically picked by the Zephyr
 * build system when building the sample for the nRF54l15 DK (cpuapp) board.
 * It shows how the ncs-example-application can be built on sample boards
 * already provided by Zephyr or NCS.
 */
```

## src/main.c
```c
/*
 * Copyright (c) 2021 Nordic Semiconductor ASA
 * SPDX-License-Identifier: Apache-2.0
 */

#include <zephyr/kernel.h>
#include <zephyr/logging/log.h>
#include <zephyr/bluetooth/bluetooth.h>
#include <zephyr/bluetooth/gap.h>

#include <app_version.h>
#include "esl_service.h"

LOG_MODULE_REGISTER(main, CONFIG_APP_LOG_LEVEL);

/* Advertisement data */
static const struct bt_data ad[] = {
	BT_DATA_BYTES(BT_DATA_FLAGS, (BT_LE_AD_GENERAL | BT_LE_AD_NO_BREDR)),
	BT_DATA_BYTES(BT_DATA_UUID128_ALL, ESL_SERVICE_UUID_VAL),
	BT_DATA(BT_DATA_NAME_COMPLETE, CONFIG_BT_DEVICE_NAME, sizeof(CONFIG_BT_DEVICE_NAME) - 1),
};

/* Scan response data */
static const struct bt_data sd[] = {
	BT_DATA(BT_DATA_NAME_COMPLETE, CONFIG_BT_DEVICE_NAME, sizeof(CONFIG_BT_DEVICE_NAME) - 1),
};

static void bt_ready(int err)
{
	if (err) {
		LOG_ERR("Bluetooth init failed (err %d)", err);
		return;
	}

	LOG_INF("Bluetooth initialized");

	/* Initialize ESL service */
	err = esl_service_init();
	if (err) {
		LOG_ERR("ESL service init failed (err %d)", err);
		return;
	}

	/* Start advertising */
	err = bt_le_adv_start(BT_LE_ADV_CONN_NAME, ad, ARRAY_SIZE(ad), 
			      sd, ARRAY_SIZE(sd));
	if (err) {
		LOG_ERR("Advertising failed to start (err %d)", err);
		return;
	}

	LOG_INF("PSLabel ESL Service advertising started");
}

int main(void)
{
	int err;

	LOG_INF("PSLabel ESL Application %s", APP_VERSION_STRING);

	/* Initialize Bluetooth */
	err = bt_enable(bt_ready);
	if (err) {
		LOG_ERR("Bluetooth init failed (err %d)", err);
		return 0;
	}

	/* Set default display information */
	struct esl_display_info info = {
		.width = 200,
		.height = 200,
		.color_depth = 1,
		.display_type = 0x01, /* e-ink */
	};
	esl_service_set_display_info(&info);

	LOG_INF("ESL Service ready - waiting for BLE connections");

	while (1) {
		/* Main application loop */
		k_sleep(K_SECONDS(1));
		
		/* Periodically log status for debugging */
		static int counter = 0;
		if (++counter % 30 == 0) {
			LOG_INF("ESL Status: 0x%02x", esl_service_get_status());
		}
	}

	return 0;
}
```

## src/esl_service.c
```c
/*
 * Copyright (c) 2025 Nordic Semiconductor ASA
 * SPDX-License-Identifier: Apache-2.0
 */

#include "esl_service.h"
#include <zephyr/logging/log.h>
#include <zephyr/kernel.h>
#include <string.h>

LOG_MODULE_REGISTER(esl_service, CONFIG_APP_LOG_LEVEL);

/* ESL service data */
static uint8_t esl_status = ESL_STATUS_IDLE;
static struct esl_display_info display_info = {
	.width = 200,
	.height = 200,
	.color_depth = 1, /* 1-bit (black/white) */
	.display_type = 0x01, /* e-ink */
};

/* Image transfer buffer */
#define ESL_IMAGE_BUFFER_SIZE 1024
static uint8_t image_buffer[ESL_IMAGE_BUFFER_SIZE];
static size_t image_offset = 0;
static size_t image_total_size = 0;

/* Connection reference for notifications */
static struct bt_conn *notification_conn = NULL;

/* Forward declarations */
static ssize_t esl_control_point_write(struct bt_conn *conn,
					const struct bt_gatt_attr *attr,
					const void *buf, uint16_t len,
					uint16_t offset, uint8_t flags);

static ssize_t esl_image_transfer_write(struct bt_conn *conn,
					const struct bt_gatt_attr *attr,
					const void *buf, uint16_t len,
					uint16_t offset, uint8_t flags);

static ssize_t esl_display_info_read(struct bt_conn *conn,
				      const struct bt_gatt_attr *attr,
				      void *buf, uint16_t len, uint16_t offset);

static ssize_t esl_status_read(struct bt_conn *conn,
			       const struct bt_gatt_attr *attr,
			       void *buf, uint16_t len, uint16_t offset);

static void esl_status_ccc_changed(const struct bt_gatt_attr *attr, uint16_t value);

/* ESL Service Declaration */
BT_GATT_SERVICE_DEFINE(esl_service,
	BT_GATT_PRIMARY_SERVICE(ESL_SERVICE_UUID),

	/* ESL Control Point Characteristic */
	BT_GATT_CHARACTERISTIC(ESL_CONTROL_POINT_UUID,
			       BT_GATT_CHRC_WRITE | BT_GATT_CHRC_WRITE_WITHOUT_RESP,
			       BT_GATT_PERM_WRITE,
			       NULL, esl_control_point_write, NULL),

	/* ESL Image Transfer Characteristic */
	BT_GATT_CHARACTERISTIC(ESL_IMAGE_TRANSFER_UUID,
			       BT_GATT_CHRC_WRITE | BT_GATT_CHRC_WRITE_WITHOUT_RESP,
			       BT_GATT_PERM_WRITE,
			       NULL, esl_image_transfer_write, NULL),

	/* ESL Display Information Characteristic */
	BT_GATT_CHARACTERISTIC(ESL_DISPLAY_INFO_UUID,
			       BT_GATT_CHRC_READ,
			       BT_GATT_PERM_READ,
			       esl_display_info_read, NULL, NULL),

	/* ESL Status Characteristic */
	BT_GATT_CHARACTERISTIC(ESL_STATUS_UUID,
			       BT_GATT_CHRC_READ | BT_GATT_CHRC_NOTIFY,
			       BT_GATT_PERM_READ,
			       esl_status_read, NULL, NULL),
	BT_GATT_CCC(esl_status_ccc_changed, BT_GATT_PERM_READ | BT_GATT_PERM_WRITE),
);

/* ESL Control Point write handler */
static ssize_t esl_control_point_write(struct bt_conn *conn,
					const struct bt_gatt_attr *attr,
					const void *buf, uint16_t len,
					uint16_t offset, uint8_t flags)
{
	const uint8_t *data = buf;
	
	if (len < 1) {
		LOG_WRN("Invalid control point command length: %d", len);
		return BT_GATT_ERR(BT_ATT_ERR_INVALID_ATTRIBUTE_LEN);
	}

	uint8_t cmd = data[0];
	LOG_INF("ESL Control Point command: 0x%02x", cmd);

	switch (cmd) {
	case ESL_CMD_UPDATE_DISPLAY:
		LOG_INF("Update display command received");
		esl_status = ESL_STATUS_UPDATING;
		esl_service_notify_status(esl_status);
		/* Simulate display update */
		k_sleep(K_MSEC(100));
		esl_status = ESL_STATUS_IDLE;
		esl_service_notify_status(esl_status);
		break;

	case ESL_CMD_CLEAR_DISPLAY:
		LOG_INF("Clear display command received");
		esl_status = ESL_STATUS_UPDATING;
		esl_service_notify_status(esl_status);
		/* Clear image buffer */
		memset(image_buffer, 0, sizeof(image_buffer));
		image_offset = 0;
		image_total_size = 0;
		esl_status = ESL_STATUS_IDLE;
		esl_service_notify_status(esl_status);
		break;

	case ESL_CMD_SLEEP:
		LOG_INF("Sleep command received");
		esl_status = ESL_STATUS_SLEEPING;
		esl_service_notify_status(esl_status);
		break;

	case ESL_CMD_WAKE:
		LOG_INF("Wake command received");
		esl_status = ESL_STATUS_IDLE;
		esl_service_notify_status(esl_status);
		break;

	case ESL_CMD_GET_STATUS:
		LOG_INF("Get status command received");
		esl_service_notify_status(esl_status);
		break;

	default:
		LOG_WRN("Unknown control point command: 0x%02x", cmd);
		return BT_GATT_ERR(BT_ATT_ERR_VALUE_NOT_ALLOWED);
	}

	return len;
}

/* ESL Image Transfer write handler */
static ssize_t esl_image_transfer_write(struct bt_conn *conn,
					const struct bt_gatt_attr *attr,
					const void *buf, uint16_t len,
					uint16_t offset, uint8_t flags)
{
	const uint8_t *data = buf;
	
	LOG_INF("Image transfer: %d bytes at offset %d", len, offset);

	/* Handle image data transfer */
	if (offset == 0) {
		/* First packet - could contain size information */
		if (len >= 4) {
			/* Assume first 4 bytes contain total image size */
			image_total_size = (data[0] << 24) | (data[1] << 16) | 
					   (data[2] << 8) | data[3];
			LOG_INF("Image total size: %zu bytes", image_total_size);
			
			/* Copy remaining data */
			if (len > 4) {
				size_t copy_len = MIN(len - 4, ESL_IMAGE_BUFFER_SIZE);
				memcpy(image_buffer, data + 4, copy_len);
				image_offset = copy_len;
			}
		}
	} else {
		/* Subsequent packets */
		size_t copy_len = MIN(len, ESL_IMAGE_BUFFER_SIZE - image_offset);
		if (copy_len > 0) {
			memcpy(image_buffer + image_offset, data, copy_len);
			image_offset += copy_len;
		}
	}

	LOG_INF("Image buffer: %zu/%zu bytes", image_offset, image_total_size);

	/* Check if transfer is complete */
	if (image_total_size > 0 && image_offset >= image_total_size) {
		LOG_INF("Image transfer complete");
		/* Here you would trigger actual display update */
	}

	return len;
}

/* ESL Display Information read handler */
static ssize_t esl_display_info_read(struct bt_conn *conn,
				      const struct bt_gatt_attr *attr,
				      void *buf, uint16_t len, uint16_t offset)
{
	LOG_INF("Display info read requested");
	return bt_gatt_attr_read(conn, attr, buf, len, offset, 
				 &display_info, sizeof(display_info));
}

/* ESL Status read handler */
static ssize_t esl_status_read(struct bt_conn *conn,
			       const struct bt_gatt_attr *attr,
			       void *buf, uint16_t len, uint16_t offset)
{
	LOG_INF("Status read: 0x%02x", esl_status);
	return bt_gatt_attr_read(conn, attr, buf, len, offset, 
				 &esl_status, sizeof(esl_status));
}

/* ESL Status CCC changed handler */
static void esl_status_ccc_changed(const struct bt_gatt_attr *attr, uint16_t value)
{
	bool notifications_enabled = (value == BT_GATT_CCC_NOTIFY);
	LOG_INF("Status notifications %s", notifications_enabled ? "enabled" : "disabled");
}

/* Public API functions */

int esl_service_init(void)
{
	LOG_INF("ESL Service initialized");
	return 0;
}

int esl_service_notify_status(uint8_t status)
{
	int err;
	
	if (notification_conn) {
		err = bt_gatt_notify(notification_conn, &esl_service.attrs[7], 
				     &status, sizeof(status));
		if (err) {
			LOG_WRN("Failed to send status notification: %d", err);
			return err;
		}
		LOG_INF("Status notification sent: 0x%02x", status);
	}
	
	esl_status = status;
	return 0;
}

uint8_t esl_service_get_status(void)
{
	return esl_status;
}

int esl_service_set_display_info(const struct esl_display_info *info)
{
	if (!info) {
		return -EINVAL;
	}
	
	memcpy(&display_info, info, sizeof(display_info));
	LOG_INF("Display info updated: %dx%d, depth: %d, type: %d",
		info->width, info->height, info->color_depth, info->display_type);
	
	return 0;
}

/* Bluetooth connection callbacks */
static void connected(struct bt_conn *conn, uint8_t err)
{
	if (err) {
		LOG_ERR("Connection failed (err 0x%02x)", err);
		return;
	}

	notification_conn = bt_conn_ref(conn);
	LOG_INF("ESL Service: Connected");
}

static void disconnected(struct bt_conn *conn, uint8_t reason)
{
	LOG_INF("ESL Service: Disconnected (reason 0x%02x)", reason);
	
	if (notification_conn) {
		bt_conn_unref(notification_conn);
		notification_conn = NULL;
	}
}

BT_CONN_CB_DEFINE(conn_callbacks) = {
	.connected = connected,
	.disconnected = disconnected,
};
```

## src/esl_service.h
```c
/*
 * Copyright (c) 2025 Nordic Semiconductor ASA
 * SPDX-License-Identifier: Apache-2.0
 */

#ifndef ESL_SERVICE_H_
#define ESL_SERVICE_H_

#include <zephyr/bluetooth/bluetooth.h>
#include <zephyr/bluetooth/gatt.h>
#include <zephyr/bluetooth/uuid.h>

#ifdef __cplusplus
extern "C" {
#endif

/**
 * @brief Electronic Shelf Label (ESL) Service UUID
 * As defined in Bluetooth ESL specification
 */
#define ESL_SERVICE_UUID_VAL \
	BT_UUID_128_ENCODE(0x0000181D, 0x0000, 0x1000, 0x8000, 0x00805f9b34fb)

/**
 * @brief ESL Control Point Characteristic UUID
 */
#define ESL_CONTROL_POINT_UUID_VAL \
	BT_UUID_128_ENCODE(0x00002BE1, 0x0000, 0x1000, 0x8000, 0x00805f9b34fb)

/**
 * @brief ESL Image Transfer Characteristic UUID
 */
#define ESL_IMAGE_TRANSFER_UUID_VAL \
	BT_UUID_128_ENCODE(0x00002BE2, 0x0000, 0x1000, 0x8000, 0x00805f9b34fb)

/**
 * @brief ESL Display Information Characteristic UUID
 */
#define ESL_DISPLAY_INFO_UUID_VAL \
	BT_UUID_128_ENCODE(0x00002BE3, 0x0000, 0x1000, 0x8000, 0x00805f9b34fb)

/**
 * @brief ESL Status Characteristic UUID
 */
#define ESL_STATUS_UUID_VAL \
	BT_UUID_128_ENCODE(0x00002BE4, 0x0000, 0x1000, 0x8000, 0x00805f9b34fb)

/* Define UUIDs */
#define ESL_SERVICE_UUID          BT_UUID_DECLARE_128(ESL_SERVICE_UUID_VAL)
#define ESL_CONTROL_POINT_UUID    BT_UUID_DECLARE_128(ESL_CONTROL_POINT_UUID_VAL)
#define ESL_IMAGE_TRANSFER_UUID   BT_UUID_DECLARE_128(ESL_IMAGE_TRANSFER_UUID_VAL)
#define ESL_DISPLAY_INFO_UUID     BT_UUID_DECLARE_128(ESL_DISPLAY_INFO_UUID_VAL)
#define ESL_STATUS_UUID           BT_UUID_DECLARE_128(ESL_STATUS_UUID_VAL)

/**
 * @brief ESL Control Point Commands
 */
enum esl_control_cmd {
	ESL_CMD_UPDATE_DISPLAY = 0x01,
	ESL_CMD_CLEAR_DISPLAY = 0x02,
	ESL_CMD_SLEEP = 0x03,
	ESL_CMD_WAKE = 0x04,
	ESL_CMD_GET_STATUS = 0x05,
};

/**
 * @brief ESL Status Values
 */
enum esl_status {
	ESL_STATUS_IDLE = 0x00,
	ESL_STATUS_UPDATING = 0x01,
	ESL_STATUS_SLEEPING = 0x02,
	ESL_STATUS_ERROR = 0xFF,
};

/**
 * @brief ESL Display Information Structure
 */
struct esl_display_info {
	uint16_t width;
	uint16_t height;
	uint8_t color_depth;
	uint8_t display_type;
} __packed;

/**
 * @brief Initialize the ESL service
 * 
 * @return 0 on success, negative errno code on failure
 */
int esl_service_init(void);

/**
 * @brief Send notification to ESL Status characteristic
 * 
 * @param status The status value to send
 * @return 0 on success, negative errno code on failure
 */
int esl_service_notify_status(uint8_t status);

/**
 * @brief Get current ESL status
 * 
 * @return Current ESL status
 */
uint8_t esl_service_get_status(void);

/**
 * @brief Set ESL display information
 * 
 * @param info Pointer to display information structure
 * @return 0 on success, negative errno code on failure
 */
int esl_service_set_display_info(const struct esl_display_info *info);

#ifdef __cplusplus
}
#endif

#endif /* ESL_SERVICE_H_ */
```
